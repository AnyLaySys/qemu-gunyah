## hw/Kconfig
```kconfig
source audio/Kconfig
source block/Kconfig
source char/Kconfig
source core/Kconfig
source display/Kconfig
source input/Kconfig
source intc/Kconfig
source net/Kconfig
source nvram/Kconfig
source pci-host/Kconfig
source pci/Kconfig
source rtc/Kconfig
source virtio/Kconfig

source arm/Kconfig
source cpu/Kconfig

config TEST_DEVICES
    bool

config AARCH64
    bool
    default y
config ARM
    bool
    default y
```

## hw/acpi/Kconfig
```kconfig
config ACPI
    bool

config ACPI_X86
    bool

config ACPI_ICH9
    bool

config ACPI_CPU_HOTPLUG
    bool

config ACPI_PIIX4
    bool

config ACPI_PCIHP
    bool

config ACPI_PCI_BRIDGE
    bool

config ACPI_APEI
    bool
    depends on ACPI

config ACPI_PCI
    bool
    depends on ACPI && PCI

config ACPI_VMGENID
    bool

config ACPI_VMCLOCK
    bool

config ACPI_HW_REDUCED
    bool
    select ACPI
```

## hw/arm/Kconfig
```kconfig
config ARM_VIRT
    bool
    default y
    depends on ARM
    select ARM_GIC
    select DEVICE_TREE
    select PCI_EXPRESS
    select PCI_EXPRESS_GENERIC_BRIDGE
    select PL011
    select PL031
```

## hw/cpu/Kconfig
```kconfig
config A9MPCORE
    bool
    select A9SCU       # snoop control unit
    select ARM_GIC

config A15MPCORE
    bool
    select ARM_GIC

config ARM11MPCORE
    bool
    select ARM11SCU

config CPU_CLUSTER
    bool
```

## hw/display/Kconfig
```kconfig
config EDID
    bool

config VIRTIO_GPU
    bool
    default y
    depends on VIRTIO
    select EDID
```

## hw/intc/Kconfig
```kconfig
config ARM_GIC
    bool
    select ARM_GICV3 if GH
    select MSI_NONBROKEN

config ARM_GICV3
    bool
    depends on ARM_GIC
```

## hw/remote/Kconfig
```kconfig
config MULTIPROCESS
    bool
    depends on MULTIPROCESS_SUPPORTED
    select REMOTE_PCIHOST

config VFIO_USER_SERVER
    bool
    depends on MULTIPROCESS

config MULTIPROCESS_SUPPORTED
    bool
```

## hw/rtc/Kconfig
```kconfig
config DS1338
    bool

config M41T80
    bool

config M48T59
    bool

config PL031
    bool

config MC146818RTC
    bool

config SUN4V_RTC
    bool

config GOLDFISH_RTC
    bool

config LS7A_RTC
    bool

config RS5C372_RTC
    bool
```

## hw/virtio/Kconfig
```kconfig
config VIRTIO
    bool

config VIRTIO_PCI
    bool
    default y if PCI_DEVICES
    depends on PCI
    select VIRTIO
    select VIRTIO_MD_SUPPORTED

config VIRTIO_MMIO
    bool
    select VIRTIO

config VIRTIO_MD_SUPPORTED
    bool
```

## hw/watchdog/Kconfig
```kconfig
config CMSDK_APB_WATCHDOG
    bool
    select PTIMER

config WDT_IB6300ESB
    bool
    default y if PCI_DEVICES
    depends on PCI

config WDT_IB700
    bool

config WDT_DIAG288
    bool

config WDT_IMX2
    bool

config WDT_SBSA
    bool

config ALLWINNER_WDT
    bool
    select PTIMER
```

## target/arm/Kconfig
```kconfig
config ARM
    bool
    select DEVICE_TREE # needed by boot.c

config AARCH64
    bool
    select ARM
```
